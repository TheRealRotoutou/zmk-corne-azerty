## config/boards/shields/cornazerty/Kconfig.defconfig
```kconfig
if SHIELD_CORNAZERTY_LEFT

config ZMK_KEYBOARD_NAME
    default "Cornazerty"

config ZMK_SPLIT_ROLE_CENTRAL
    default y

endif

if SHIELD_CORNAZERTY_LEFT || SHIELD_CORNAZERTY_RIGHT

config ZMK_SPLIT
    default y

endif
```

## config/boards/shields/cornazerty/Kconfig.shield
```kconfig
config SHIELD_CORNAZERTY_LEFT
    def_bool $(shields_list_contains,cornazerty_left)

config SHIELD_CORNAZERTY_RIGHT
    def_bool $(shields_list_contains,cornazerty_right)
```
